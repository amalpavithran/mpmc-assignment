ORG 0
	MOV P1,#0FFH	//SET P1 AS INPUT
	START:
	JB P1.0,SP1	//JUMP TO SPEED 1/5
	JB P1.1,SP2	//JUMP TO SPEED 2/5
	JB P1.2,SP3	//JUMP TO SPEED 3/5
	JB P1.3,SP4	//JUMP TO SPEED 4/5
	JB P1.4,SP5	//JUMP TO SPEED 5/5
	SP0:
		
		//MOTOR SPEED 0/5
		CLR P2.0
		SJMP START
		
		//MOTOR SPEED 1/5
		SP1:
		MOV R0,#51
		SJMP PWM
		
		//MOTOR SPEED 2/5
		SP2:
		MOV R0,#102
		SJMP PWM
		
		//MOTOR SPEED 3/5
		SP3:
		MOV R0,#153
		SJMP PWM
		
		//MOTOR SPEED 4/5
		SP4:
		MOV R0,#204
		SJMP PWM
		
		//MOTOR SPEED 5/5
		SP5:
		SETB P2.0
		SJMP START
		
		PWM:
		//R0 IS POSITIVE CYCLE DELAY
		//R1 IS NEGATIVE CYCLE DELAY
		
		MOV A,#0FFH	//MOVES 255 INTO A
		SUBB A,R0	//255 - R0
		MOV R1,A	//GENERATE R1
		
		//START POSITIVE CYCLE
		SETB P2.0
		HERE: DJNZ R0,HERE
		
		//START NEGATIVE CYCLE
		CLR P2.0
		HERE2: DJNZ R1,HERE2
		SJMP START
END