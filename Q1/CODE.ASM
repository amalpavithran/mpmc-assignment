ORG 0
	
//TIMER FOR BAUD RATE 9600
MOV TMOD, #20H
MOV TH1, #0FDH
MOV SCON, #50H
SETB TR1  //START TIMER

//SET TO USE 2 LINES
MOV A,#38H
ACALL COMMAND
ACALL DELAY

//INITIALIZE LCD
MOV A,#0EH
ACALL COMMAND
ACALL DELAY

//CLEAR SCREEN
MOV A,#01H	
ACALL COMMAND
ACALL DELAY

	START:
	
	//WAIT FOR INPUT FROM KEYBOARD
	HERE: JNB RI,HERE
		MOV A,SBUF
	
	//HANDLE BACKSPACE
	CJNE A,#08H,NEWLINE
	MOV A,#10H //DECREMENT CURSOR
	ACALL COMMAND
	MOV A,#' ' //CLEAR CURSOR
	ACALL SENT
	MOV A,#10H //DECREMENT CURSOR
	ACALL COMMAND
	CLR RI  //CLEAR RECEIVE INTERRUPT FLAG
	SJMP START
	
	//HANDLE ENTER KEY
	NEWLINE:
	CJNE A,#0DH,HELLO
	MOV A,#0C0H //JUMP TO NEXT LINE POSITION 1 ON ENTER
	ACALL COMMAND
	CLR RI  //CLEAR RECEIVE INTERRUPT FLAG
	SJMP START
	
	//HANDLE NORMAL CHARACTERS
	HELLO:
	ACALL SENT
	CLR RI
	SJMP START
	
	//COMMAND FUNCTION
	COMMAND:
		MOV P2,A
		CLR P3.2	//CLEAR RS FOR COMMANDS
		SETB P3.3	//SET ENABLE
		ACALL DELAY
		CLR P3.3	//CLEAR ENABLE
		RET
	
	//DATA FUNCTION
	SENT:
		MOV P2,A
		SETB P3.2	//SET RS FOR DATA
		SETB P3.3	//SET ENABLE
		ACALL DELAY
		CLR P3.3	//CLEAR ENABLE
		RET
	
	//NESTED DELAY OF APPROX 10MS
	DELAY:
	MOV R0,#255
	HOLD:
		MOV R1,#20
		HOLD1:DJNZ R1,HOLD1
		DJNZ R0,HOLD
		RET
END